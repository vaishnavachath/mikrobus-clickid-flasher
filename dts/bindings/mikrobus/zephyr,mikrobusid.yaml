## dts/bindings/mikrobus/zephyr,mikrobusid.yaml
```yaml
# Copyright (c) 2021  BeagleBoard.org Foundation
# SPDX-License-Identifier: Apache-2.0

description: mikroBUS Click ID support

compatible: "zephyr,mikrobusid"

include: [base.yaml]

properties:
    "id":
      type: int
      required: true
      description: mikroBUS ID
    cs-gpios:
      type: phandle-array
      required: true
      description: mikrobus CS GPIO
    rst-gpios:
      type: phandle-array
      required: true
      description: mikrobus RST GPIO
```

## subsys/mikrobus/Kconfig
```kconfig
# Kconfig - mikrobus configuration options
#
# SPDX-License-Identifier: BSD-3-Clause

menuconfig MIKROBUS
	bool "mikrobus"
	help
	  This option enables mikrobus support.

if MIKROBUS

config MIKROBUS_FLASHER_CLICK_NAME
	string "mikrobus Click Name"
	default ""
	help
	  This is the name of the Click Board which is connected
	  to the mikrobus port on the board, the click manifest
	  should already be present in the manifesto manifests
	  directory.This click manifest will be written to the 
	  eeprom memory.

module = MIKROBUS
module-str = MIKROBUS
source "subsys/logging/Kconfig.template.log_config"

endif # MIKROBUS
```

## west.yml
```yaml
manifest:
  self:
    path: mikrobus
  remotes:
    - name: zephyrproject-rtos
      url-base: https://github.com/zephyrproject-rtos
  projects:
    - name: zephyr
      remote: zephyrproject-rtos
      revision: master
      import: true
```
